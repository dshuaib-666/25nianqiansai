#include "RGB.h"
#include "tim.h"
#include "dma.h"
  #include "RGB_BOOK.h" 
   
void RGB_RESET(void)
{
  
	HAL_TIM_PWM_Start_DMA(&htim3,TIM_CHANNEL_4,(uint32_t *)Reset_buffer,172);
	  
  
  
  
}

void RGB_Test(void)
{
 HAL_TIM_PWM_Start_DMA(&htim3,TIM_CHANNEL_4,(uint32_t *)violet_buffer6,244);


}
//得先进行指定当下要发什么，然后在于接下来要发的进行比较，当一样时候，就不要运行了，不一样的话在工作，
//相当于那个oled的避免多次刷屏一样
uint32_t NOW_buffer[72]={0,0,0,0,0,0,0,0,/**/0,0,0,0,0,0,0,0,/**/0,0,0,0,0,0,0,0 ,/**/0,0,0,0,0,0,0,0,/**/0,0,0,0,0,0,0,0,/**/0,0,0,0,0,0,0,0 ,/**/0,0,0,0,0,0,0,0,/**/0,0,0,0,0,0,0,0,/**/0,0,0,0,0,0,0,0 }; //这一时刻发送的
uint32_t LAST_buffer[72]={0,0,0,0,0,0,0,0,/**/0,0,0,0,0,0,0,0,/**/0,0,0,0,0,0,0,0 ,/**/0,0,0,0,0,0,0,0,/**/0,0,0,0,0,0,0,0,/**/0,0,0,0,0,0,0,0 ,/**/0,0,0,0,0,0,0,0,/**/0,0,0,0,0,0,0,0,/**/0,0,0,0,0,0,0,0 };//上一时刻发送的 ,每次进行函数时候，将now的与last进行比较
uint32_t future[372]={0,0,0,0,0,0,0,0,0,0,0,0,0,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0 ,
0,0,0,0,0,0,0,0,0,0,0,0,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0 ,
0,0,0,0,0,0,0,0,0,0,0,0,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0 ,
0,0,0,0,0,0,0,0,0,0,0,0,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0	
};  //用于将前面的72位给NOW_buffer放入，其他位置不要动，
void RGB_Extract(void)
{
  
   for(uint8_t i=0;i<72;i++)
	{
	   if((LAST_buffer[i]==NOW_buffer[i])&&(i==71))  //如果一直相等，知道最后，那么就直接return
	   {
			return;
	   }
	   else if(LAST_buffer[i]==NOW_buffer[i]&&(i<=70)){continue;}
	   else {          //如果当前不一样，那么就进行退出当前循环，不要在继续了
		   break;
	   }
	}
	
	//出来了说明，接下来要的和当前的不一样
	//也就是将当前的NOW_buffer扩充到372数组内，也就是再后面续上300个0
	for(int i=0;i<72;i++)
	{
		future[i]=NOW_buffer[i];//将72位传入这里面
		LAST_buffer[i]=NOW_buffer[i];//顺便进行重置LASE_buffer
	}
	
	
}
//每次控制都是改变NOW的值
void RGB_Cotorl(void)   
{

}
